## sdkconfig.defaults
```kconfig
# Make sure to delete sdkconfig.* after making changes here
# so that they get regenerated!

# Won't compile without this
CONFIG_FREERTOS_HZ=1000

# Won't compile without this
CONFIG_ESP_TLS_PSK_VERIFICATION=y

# We don't need secure Boot
CONFIG_SECURE_BOOT=n
CONFIG_SECURE_FLASH_ENC_ENABLED=n

# We want to use exceptions
CONFIG_COMPILER_CXX_EXCEPTIONS=y
CONFIG_COMPILER_OPTIMIZATION_SIZE=y

# Reduce binary size
CONFIG_LWIP_IPV6=n
CONFIG_VFS_SUPPORT_TERMIOS=n
CONFIG_VFS_SUPPORT_SELECT=n

# Less chatty
CONFIG_BOOTLOADER_LOG_LEVEL_ERROR=y
CONFIG_LOG_DEFAULT_LEVEL_WARN=y
CONFIG_LOG_MAXIMUM_LEVEL_INFO=y

# We do our own coloring in debug mode
CONFIG_LOG_COLORS=n

# Seems like a good idea to have some stack checks
CONFIG_COMPILER_STACK_CHECK_MODE_NORM=y

# Give peripheral-related tasks to have some length to their names
CONFIG_FREERTOS_MAX_TASK_NAME_LEN=32

# Partition table config
CONFIG_PARTITION_TABLE_CUSTOM=y
CONFIG_PARTITION_TABLE_OFFSET=0x12000

# Increase main task stack from default 3584
CONFIG_ESP_MAIN_TASK_STACK_SIZE=6144

# Allow time to be adjusted the DHCP server's recommendation
CONFIG_LWIP_DHCP_GET_NTP_SRV=y

#
# Power management
#

# Enable automatic light sleep
CONFIG_PM_ENABLE=y
CONFIG_FREERTOS_USE_TICKLESS_IDLE=y

# Use IRAM to let device sleep 310+20us more
CONFIG_PM_SLP_IRAM_OPT=y
CONFIG_PM_RTOS_IDLE_OPT=y

# Power down stuff
CONFIG_PM_SLP_DISABLE_GPIO=y
CONFIG_PM_POWER_DOWN_CPU_IN_LIGHT_SLEEP=y
CONFIG_PM_RESTORE_CACHE_TAGMEM_AFTER_LIGHT_SLEEP=y
# TODO Experiment with this
# CONFIG_PM_POWER_DOWN_PERIPHERAL_IN_LIGHT_SLEEP=y

CONFIG_ESP_PHY_MAC_BB_PD=y

# Recalibrate the RTC_FAST/SLOW clock less often
CONFIG_PM_LIGHTSLEEP_RTC_OSC_CAL_INTERVAL=16

# Profile power management
# CONFIG_PM_PROFILING=y

# Measure light sleep time
CONFIG_PM_LIGHT_SLEEP_CALLBACKS=y

# Task profiling
# CONFIG_FREERTOS_USE_TRACE_FACILITY=y
# CONFIG_FREERTOS_USE_STATS_FORMATTING_FUNCTIONS=y
# CONFIG_FREERTOS_GENERATE_RUN_TIME_STATS=y

# Memory profiling
# CONFIG_HEAP_TRACING_STANDALONE=y
# CONFIG_HEAP_TRACING_STACK_DEPTH=10
# CONFIG_HEAP_POISONING_LIGHT=y
# CONFIG_HEAP_TASK_TRACKING=y

# Core dump
CONFIG_ESP_COREDUMP_ENABLE_TO_FLASH=y
CONFIG_ESP_COREDUMP_DATA_FORMAT_ELF=y
CONFIG_ESP_COREDUMP_CHECKSUM_SHA256=y
CONFIG_ESP_COREDUMP_LOGS=n

# Ethernet support is not enabled, so we don't need to disable it explicitly
# # We don't need Ethernet
# CONFIG_ETH_USE_SPI_ETHERNET=n

# Handle undelivered MQTT messages
CONFIG_MQTT_REPORT_DELETED_MESSAGES=y

# We don't need TLS server functionality
CONFIG_MBEDTLS_TLS_CLIENT_ONLY=y

# DS peripheral requires eFuse-provisioned keys; we use PEM keys in NVS
CONFIG_MBEDTLS_HARDWARE_RSA_DS_PERIPHERAL=n

# Use the "common" CA bundle (covers the most widely-used commercial roots)
# instead of FULL. FULL ships ~150 CAs (~110 KB of .rodata in libmbed-builtin);
# CMN is roughly half that. TODO: switch to a hand-picked custom bundle (just
# the MQTT broker chain + Cloudflare R2 OTA chain) — that drops it under 10 KB
# but requires confirming exactly which CAs both endpoints chain to.
CONFIG_MBEDTLS_CERTIFICATE_BUNDLE_DEFAULT_CMN=y

# Some CAs in the trust chain may be cross-signed by another CA (e.g. GTS Root R4
# cross-signed by GlobalSign). Without this, the bundle only contains self-signed
# roots and cannot resolve a trust path through a cross-signed intermediate,
# causing OTA to fail with MBEDTLS_ERR_X509_CERT_VERIFY_FAILED (-0x3000).
CONFIG_MBEDTLS_CERTIFICATE_BUNDLE_CROSS_SIGNED_VERIFY=y

# # Enable mbedTLS debug interface
# CONFIG_MBEDTLS_DEBUG=y
# # Level 3 = informational (includes X509 verify chain details)
# # Level 4 = verbose (very noisy, usually not needed)
# CONFIG_MBEDTLS_DEBUG_LEVEL=3

# Allow outdated network provisioning security protocols
CONFIG_ESP_PROTOCOMM_SUPPORT_SECURITY_VERSION_1=y

#
# Bluetooth (NimBLE) — Device Information Service + future provisioning / local-only mode
#
CONFIG_BT_ENABLED=y
CONFIG_BT_NIMBLE_ENABLED=y
# Allow NimBLE host to enter light sleep alongside the rest of the system
CONFIG_BT_NIMBLE_SLEEP_ENABLE=y
# Enable DIS characteristics (all off by default; runtime setters are no-ops without these)
CONFIG_BT_NIMBLE_SVC_DIS_MANUFACTURER_NAME=y
CONFIG_BT_NIMBLE_SVC_DIS_FIRMWARE_REVISION=y
CONFIG_BT_NIMBLE_SVC_DIS_SERIAL_NUMBER=y

# --- Optional NimBLE size-reduction knobs (review before enabling) -------------
# Default NimBLE config compiles in all four roles, BLE5 features, and supports
# up to 3 simultaneous connections — together this is ~235 KB in libble_app.a.
# As of now we only use BLE as a *peripheral* (advertising DIS, future Wi-Fi
# provisioning). If devices later need to scan or connect to BLE peripherals
# of their own (e.g. soil sensors), they must keep the CENTRAL role enabled
# — disabling CENTRAL means we can advertise but cannot initiate connections.
#
# Estimated savings (combined ~60–100 KB in libble_app.a; verify with `idf.py size`):
#
# # Drop the Central role (no outgoing connections, no scanning for connectable peers).
# # Required if we later want to talk to BLE soil sensors as a client.
# # CONFIG_BT_NIMBLE_ROLE_CENTRAL=n
#
# # Drop the Observer role (no passive scanning for beacons / advertisements).
# # CONFIG_BT_NIMBLE_ROLE_OBSERVER=n
#
# # Cap simultaneous connections at 1 — we only ever talk to one phone/provisioner.
# # Each extra slot costs ~1–2 KB RAM + some flash.
# # CONFIG_BT_NIMBLE_MAX_CONNECTIONS=1
#
# # Disable BLE 5.0 extended/periodic advertising and 2M/Coded PHY. Phones do
# # provisioning over legacy 1M PHY; we don't need extended adv for DIS.
# # CONFIG_BT_NIMBLE_EXT_ADV=n
# # CONFIG_BT_NIMBLE_PERIODIC_ADV=n
# # CONFIG_BT_NIMBLE_50_FEATURE_SUPPORT=n
#
# # Disable L2CAP connection-oriented channels (we only use ATT/GATT).
# # CONFIG_BT_NIMBLE_L2CAP_COC_MAX_NUM=0
# ------------------------------------------------------------------------------
```
