#include "PulseCounter.hpp"

#include <cinttypes>
#include <cstddef>
#include <cstdint>
#include <memory>
#include <stdexcept>
#include <utility>

#include <freertos/task.h>

#include <driver/gpio.h>
#include <esp_err.h>
#include <esp_pm.h>
#include <hal/rtc_io_types.h>

#include "Pin.hpp"

#ifdef CONFIG_ULP_COPROC_ENABLED
#include <driver/rtc_io.h>
#if defined(CONFIG_ULP_COPROC_TYPE_RISCV)
#include <ulp_common.h>
#include <ulp_riscv.h>
#ifdef FARMHUB_DEBUG
#include <bits/chrono.h>
#include <soc/rtc_cntl_reg.h>
#include <soc/sens_reg.h>
#include <soc/soc.h>

#include <Task.hpp>

using namespace std::chrono_literals;
#endif
#elif defined(CONFIG_ULP_COPROC_TYPE_LP_CORE)
#include <ulp_lp_core.h>
#endif
// Generated by the ULP build system from ulp/pulse_counter.c.
// The build system prepends "ulp_" to each exported variable name, so
// channel_count → ulp_channel_count, gpio_num → ulp_gpio_num, etc.
#include "ulp_pulse_counter.h"
// Embedded ULP binary produced by CMake.
extern const uint8_t ulp_pulse_counter_bin_start[] asm("_binary_ulp_pulse_counter_bin_start"); // NOLINT(hicpp-no-assembler)
extern const uint8_t ulp_pulse_counter_bin_end[]   asm("_binary_ulp_pulse_counter_bin_end");   // NOLINT(hicpp-no-assembler)
#endif

#include <EspException.hpp>
#include <Log.hpp>

using namespace std::chrono;

namespace farmhub::kernel {

// ============================================================================
// UlpPulseCounter — RTC/LP GPIO path, no per-pulse CPU wakeups
// ============================================================================

#ifdef CONFIG_ULP_COPROC_ENABLED

/**
 * @brief Pulse counter backed by the ULP/LP-core coprocessor.
 *
 * The coprocessor polls the GPIO continuously regardless of main CPU sleep state:
 * - ESP32-S3 (ULP-RISC-V): ~17.5 MHz polling rate; requires an RTC-capable GPIO (GPIO 0–21).
 * - ESP32-C6 (LP Core): ~16 MHz polling rate; requires an LP-capable GPIO (GPIO 0–7).
 *
 * The main CPU reads the monotonically increasing counter from RTC slow memory and
 * computes the delta since the last read. No wakeup sources are registered per pulse.
 *
 * PulseCounterManager::start() must be called after all channels are created.
 *
 * See docs/ULP-PulseCounter.md for full design rationale.
 */
class UlpPulseCounter final : public PulseCounter {
public:
    uint32_t getCount() const override {
        if (ulp_running == 0U) {
            // ULP not running, so the count won't be changing
            return lastSeen;
        }
        uint32_t current = ulp_pulse_count[channelIndex];
        uint32_t delta = current - lastSeen;
        LOGTV(PULSE, "Counted %" PRIu32 " ULP pulses on pin %s, ULP running: %d",
            delta, pin->getName().c_str(), ulp_running);
        return delta;
    }

    uint32_t reset() override {
        if (ulp_running == 0U) {
            // ULP not running, so the count won't be changing
            return lastSeen;
        }
        uint32_t current = ulp_pulse_count[channelIndex];
        uint32_t delta = current - lastSeen;
        lastSeen = current;
        LOGTV(PULSE, "Counted %" PRIu32 " ULP pulses and cleared on pin %s, ULP running: %d",
            delta, pin->getName().c_str(), ulp_running);
        return delta;
    }

    PinPtr getPin() const override {
        return pin;
    }

private:
    UlpPulseCounter(InternalPinPtr pin, uint32_t channelIndex)
        : pin(std::move(pin))
        , channelIndex(channelIndex) {
    }

    const InternalPinPtr pin;
    const uint32_t channelIndex;
    uint32_t lastSeen = 0;

    friend class PulseCounterManager;
};

#endif    // CONFIG_ULP_COPROC_ENABLED

// ============================================================================
// PulseCounterManager
// ============================================================================

std::shared_ptr<PulseCounter> PulseCounterManager::create(const PulseCounterConfig& config) {
    auto gpio = config.pin->getGpio();

#ifdef CONFIG_ULP_COPROC_ENABLED
    if (rtc_gpio_is_valid_gpio(gpio)) {
        return createUlp(config);
    }
#endif
    return createGpio(config);
}

void PulseCounterManager::start() {
#ifdef CONFIG_ULP_COPROC_ENABLED
    if (ulpStarted || ulpNextChannel == 0) {
        return;
    }
    ulpStarted = true;

    // NOLINTNEXTLINE(clang-analyzer-security.PointerSub) -- linker-emitted symbols, not a real array
    size_t size = ulp_pulse_counter_bin_end - ulp_pulse_counter_bin_start;
    LOGTD(PULSE, "Loading ULP binary (%zu bytes from %p to %p)", size, ulp_pulse_counter_bin_start, ulp_pulse_counter_bin_end);
#if defined(CONFIG_ULP_COPROC_TYPE_RISCV)
    ESP_ERROR_THROW(ulp_riscv_load_binary(ulp_pulse_counter_bin_start, size));
    // Restart the ULP every 1000 µs after each ulp_riscv_halt() call.
    // Must be set before ulp_riscv_run(); matches ULP_TIMER_PERIOD_US in pulse_counter.c.
    ESP_ERROR_THROW(ulp_set_wakeup_period(0, 1000));
#elif defined(CONFIG_ULP_COPROC_TYPE_LP_CORE)
    ESP_ERROR_THROW(ulp_lp_core_load_binary(ulp_pulse_counter_bin_start, size));
#endif

    ulp_channel_count = ulpNextChannel;
    for (uint32_t i = 0; i < ulpNextChannel; i++) {
        ulp_gpio_num[i]    = ulpChannelConfigs[i].gpioNum;
        ulp_debounce_us[i] = ulpChannelConfigs[i].debounceUs;
        ulp_pulse_count[i] = 0;
    }

#if defined(CONFIG_ULP_COPROC_TYPE_RISCV)
    ESP_ERROR_THROW(ulp_riscv_run());
#ifdef FARMHUB_DEBUG
    // Give the ULP a moment to run and halt; then check registers to see if it actually executed.
    Task::delay(100ms);
    // NOLINTBEGIN(cppcoreguidelines-pro-type-cstyle-cast,performance-no-int-to-ptr) -- ESP-IDF REG_READ macro
    uint32_t cocpuCtrl = REG_READ(RTC_CNTL_COCPU_CTRL_REG);
    uint32_t sensState = REG_READ(SENS_SAR_COCPU_STATE_REG);
    uint32_t intRaw = REG_READ(RTC_CNTL_INT_RAW_REG);
    // NOLINTEND(cppcoreguidelines-pro-type-cstyle-cast,performance-no-int-to-ptr)
    LOGTD(PULSE, "COCPU_CTRL=0x%" PRIx32 " SENSE=0x%" PRIx32 " DONE=%d TRAP=%d TRAP_INT_RAW=%d running=%" PRIu32,
        cocpuCtrl,
        sensState,
        static_cast<int>((cocpuCtrl & RTC_CNTL_COCPU_DONE_M) != 0),
        static_cast<int>((sensState & SENS_COCPU_TRAP_M) != 0),
        static_cast<int>((intRaw & RTC_CNTL_COCPU_TRAP_INT_RAW_M) != 0),
        ulp_running);
#endif
#elif defined(CONFIG_ULP_COPROC_TYPE_LP_CORE)
    ulp_lp_core_cfg_t cfg = {
        .wakeup_source = ULP_LP_CORE_WAKEUP_SOURCE_HP_CPU,
        .lp_timer_sleep_duration_us = 0, // Not used with HP CPU wakeup source
    };
    ESP_ERROR_THROW(ulp_lp_core_run(&cfg));
#endif
    LOGTD(PULSE, "ULP pulse counter started with %" PRIu32 " channel(s)", ulpNextChannel);
#endif
}

#ifdef CONFIG_ULP_COPROC_ENABLED

std::shared_ptr<PulseCounter> PulseCounterManager::createUlp(const PulseCounterConfig& config) {
    if (ulpNextChannel >= ULP_MAX_CHANNELS) {
        throw std::runtime_error("PulseCounterManager: ULP channel limit exceeded");
    }

    auto gpio = config.pin->getGpio();

    // Route pin to RTC/LP domain with pull-down.
    ESP_ERROR_THROW(rtc_gpio_init(gpio));
    ESP_ERROR_THROW(rtc_gpio_set_direction(gpio, RTC_GPIO_MODE_INPUT_ONLY));
    ESP_ERROR_THROW(rtc_gpio_pulldown_en(gpio));
    ESP_ERROR_THROW(rtc_gpio_pullup_dis(gpio));

    uint32_t index = ulpNextChannel++;

    auto debounceUs = static_cast<uint32_t>(config.debounceTime.count());
    // Buffer config — written to ULP shared memory after load_binary() in start(),
    // because load_binary() resets all of RTC slow memory to initial values.
    ulpChannelConfigs[index] = {
        .gpioNum = static_cast<uint32_t>(gpio),
        .debounceUs = debounceUs,
    };

    LOGTD(PULSE, "Registered ULP pulse counter on pin %s (channel %" PRIu32 ", debounce %" PRIu32 " us)",
        config.pin->getName().c_str(), index, debounceUs);

    auto ulpCounter = std::shared_ptr<UlpPulseCounter>(new UlpPulseCounter(config.pin, index));
    ulpCounters.push_back(ulpCounter);
    return ulpCounter;
}

#endif    // CONFIG_ULP_COPROC_ENABLED

std::shared_ptr<PulseCounter> PulseCounterManager::createGpio(const PulseCounterConfig& config) {
    if (!gpioInitialized) {
        gpioInitialized = true;

        // Make sure we handle any state changes when the device wakes up due to a GPIO interrupt
        esp_pm_sleep_cbs_register_config_t sleepCallbackConfig = {
            .enter_cb = [](int64_t /*timeToSleepInUs*/, void* arg) {
                auto* self = static_cast<PulseCounterManager*>(arg);
                for (auto* counter : self->gpioCounters) {
                    counter->handleGoingToLightSleep();
                }
                return ESP_OK; },
            .exit_cb = [](int64_t /*timeSleptInUs*/, void* arg) {
                auto* self = static_cast<PulseCounterManager*>(arg);
                for (auto* counter : self->gpioCounters) {
                    counter->handleWakingUpFromLightSleep();
                }
                return ESP_OK; },
            .enter_cb_user_arg = this,
            .exit_cb_user_arg = this,
            .enter_cb_prior = 0,
            .exit_cb_prior = 0,
        };
        ESP_ERROR_THROW(esp_pm_light_sleep_register_cbs(&sleepCallbackConfig));
    }

    auto counter = std::make_shared<GpioPulseCounter>(config.pin, config.debounceTime);

    // Attach the ISR handler to the GPIO pin
    ESP_ERROR_THROW(gpio_isr_handler_add(config.pin->getGpio(), handleGpioPulseCounterInterrupt, counter.get()));

    // Keep the counter alive in the manager
    gpioCounters.push_back(counter.get());
    ulpCounters.push_back(counter);
    return counter;
}

}    // namespace farmhub::kernel
